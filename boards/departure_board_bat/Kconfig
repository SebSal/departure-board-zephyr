## boards/departure_board_bat/Kconfig.departure_board_bat
```kconfig
config BOARD_DEPARTURE_BOARD_BAT
	select SOC_ESP32C6
	select SOC_ESP32C6_HPCORE if BOARD_DEPARTURE_BOARD_BAT_ESP32C6_HPCORE
```

## boards/departure_board_bat/board.yml
```yaml
board:
  name: departure_board_bat
  full_name: Departure Board Battery
  socs:
  - name: esp32c6
```

## boards/departure_board_eink/Kconfig.departure_board_eink
```kconfig
config BOARD_DEPARTURE_BOARD_EINK
	select SOC_ESP32_C6_WROOM_1U_N4
	select SOC_ESP32C6_HPCORE if BOARD_DEPARTURE_BOARD_EINK_ESP32C6_HPCORE
```

## boards/departure_board_eink/board.yml
```yaml
board:
  name: departure_board_eink
  full_name: Departure Board E-Ink
  socs:
  - name: esp32c6
```
